## config/boards/shields/sofle/Kconfig.shield
```kconfig
# Copyright (c) 2020 Ryan Cross
# SPDX-License-Identifier: MIT

config ZMK_SPLIT_BLE_ROLE_CENTRAL
	def_bool $(shields_list_contains,sofle_central)

config SHIELD_SOFLE_LEFT
	def_bool $(shields_list_contains,sofle_left)

config SHIELD_SOFLE_RIGHT
	def_bool $(shields_list_contains,sofle_right)
```

## config/boards/shields/sofle_v11/Kconfig.defconfig
```kconfig
config ZMK_BLE
	default y

config ZMK_USB
	default y

if SHIELD_SOFLE_V11_DONGLE

config ZMK_KEYBOARD_NAME
	default "Sofle v11"

endif

if SHIELD_SOFLE_V11_LEFTCENTRAL

config ZMK_KEYBOARD_NAME
	default "Sofle v11 Left"

endif

if SHIELD_SOFLE_V11_RIGHTCENTRAL

config ZMK_KEYBOARD_NAME
	default "Sofle v11 Right"

endif

if SHIELD_SOFLE_V11_DONGLE || SHIELD_SOFLE_V11_LEFTCENTRAL || SHIELD_SOFLE_V11_RIGHTCENTRAL

config ZMK_SPLIT
	default y

config ZMK_SPLIT_BLE_ROLE_CENTRAL
	default y

endif

if SHIELD_SOFLE_V11_LEFTCENTRAL || SHIELD_SOFLE_V11_RIGHTCENTRAL
config ZMK_BATTERY_VOLTAGE_DIVIDER
	default y

if ZMK_DISPLAY

config I2C
	default y

config SSD1306
	default y

config SSD1306_REVERSE_MODE
	default y

endif # ZMK_DISPLAY

if LVGL

config LVGL_HOR_RES_MAX
	default 128

config LVGL_VER_RES_MAX
	default 32

config LVGL_VDB_SIZE
	default 64

config LVGL_DPI
	default 148

config LVGL_BITS_PER_PIXEL
	default 1

choice LVGL_COLOR_DEPTH
	default LVGL_COLOR_DEPTH_1
endchoice

endif # LVGL

endif
```

## config/boards/shields/sofle_v11/Kconfig.shield
```kconfig
config SHIELD_SOFLE_V11_DONGLE
	def_bool $(shields_list_contains,sofle_v11_dongle)

config SHIELD_SOFLE_V11_LEFT
	def_bool $(shields_list_contains,sofle_v11_leftcentral)

config SHIELD_SOFLE_V11_RIGHT
	def_bool $(shields_list_contains,sofle_v11_rightcentral)
```

## config/west.yml
```yaml
manifest:
  remotes:
    - name: zmkfirmware
      url-base: https://github.com/zmkfirmware
   - name: slicemk
      url-base: https://github.com/slicemk
  projects:
    - name: slicemk
      remote: zmkfirmware
      revision: dongle-pr
      import: app/west.yml
  self:
    path: config
```
